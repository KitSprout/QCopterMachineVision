/*====================================================================================================*/
/*====================================================================================================*/
#include "drivers\stm32f4_system.h"
#include "modules\serial.h"

#include "qCopterMV.h"
/*====================================================================================================*/
/*====================================================================================================*/
void UART_RecvEven( void )
{
  uint8_t recvData = Serial_RecvByte();
  if(recvData == 0x0D)
    Serial_SendStr("\r\n");
  else
    Serial_SendByte(recvData);
}

void QMV_Init( void )
{
  HAL_InitTick();

  QMV_GPIO_Config();
  QMV_UART_Config(UART_RecvEven);
}
/*====================================================================================================*/
/*====================================================================================================*/
void QMV_Loop( void )
{
  while(1) {
    if(KEY_Read()) {
      printf("\f");
    }
  }
}
/*====================================================================================================*/
/*====================================================================================================*/
