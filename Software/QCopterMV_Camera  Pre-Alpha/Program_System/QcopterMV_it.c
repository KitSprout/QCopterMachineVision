/*=====================================================================================================*/
/*=====================================================================================================*/
#include "stm32f4_system.h"
#include "stm32f4_i2c.h"
#include "stm32f4_sdio.h"
#include "module_ssd1963.h"
#include "DI_Sensor.h" // #include "module_mt9v022.h"
/*=====================================================================================================*/
/*=====================================================================================================*/
#define KEY   PBI(2)
#define LED_R PCO(15)
#define LED_G PCO(14)
#define LED_B PCO(13)
/*=====================================================================================================*/
/*=====================================================================================================*/
void SysTick_Handler( void )
{
}
/*=====================================================================================================*/
/*=====================================================================================================*/
void DCMI_IRQHandler(void)
{
//  if( DCMI_GetITStatus(DCMI_IT_FRAME)!= RESET) {
//    LED_B = ~LED_B;

//    TFT_DrawGrayPicture(10, 10, FULL_IMAGE_ROW_SIZE, FULL_IMAGE_COLUMN_SIZE, ImageBuf);
//    DCMI_ClearITPendingBit(DCMI_IT_FRAME);
//  }
  if(DCMI_GetITStatus(DCMI_IT_FRAME)!= RESET) {
    LED_B = ~LED_B;

    TFT_DrawPicture(10, 10, FULL_IMAGE_ROW_SIZE, FULL_IMAGE_COLUMN_SIZE, ImageBuf);
    DCMI_ClearITPendingBit(DCMI_IT_FRAME);
  }
}
/*=====================================================================================================*/
/*=====================================================================================================*/
void SDIO_IRQHandler(void)
{
  SD_ProcessIRQSrc();
}
/*=====================================================================================================*/
/*=====================================================================================================*/
void DMA2_Stream3_IRQHandler(void)
{
  SD_ProcessDMAIRQ();
}
/*=====================================================================================================*/
/*=====================================================================================================*/
void DMA1_Stream0_IRQHandler( void )
{
	I2C1_Recv_DMA_IRQ();
}
/*=====================================================================================================*/
/*=====================================================================================================*/
void DMA1_Stream6_IRQHandler( void )
{
	I2C1_Send_DMA_IRQ();
}
/*=====================================================================================================*/
/*=====================================================================================================*/
void HardFault_Handler( void )
{
  while(1);
}
void MemManage_Handler( void )
{
  while(1);
}
void BusFault_Handler( void )
{
  while(1);
}
void UsageFault_Handler( void )
{
  while(1);
}
void SVC_Handler( void )
{
  while(1);
}
void DebugMon_Handler( void )
{
  while(1);
}
void PendSV_Handler( void )
{
  while(1);
}
void NMI_Handler( void )
{
  while(1);
}
/*=====================================================================================================*/
/*=====================================================================================================*/
